## lib/utils/PID/Kconfig
```kconfig
menuconfig PID
    bool "PID"
    select DELTA_T
    help
        Enable PID lib

if PID

config PID_Derivative_LPF_RC_M1K
    int "PID Derivative LPF RC value multiply by 1000"
    default 300
    help
        PID Derivative LPF RC value multiply by 1000, for example, 300 will be turned into double 0.3

config PID_Output_LPF_RC_M1K
    int "PID Output LPF RC value multiply by 1000"
    default 300
    help
        PID Output LPF RC value, 300 will be turned into double 0.3

endif # PID
```

## scripts/west_commands/templates/Kconfig.template
```kconfig
config {CONFIG_NAME}
    bool "{DESCRIPTION}"
    depends on ONE_FRAMEWORK
    help
      Enable {MODULE_NAME} node.

if {CONFIG_NAME}

module = {CONFIG_NAME}
module-str = {CONFIG_NAME}
source "subsys/logging/Kconfig.template.log_config"

endif # {CONFIG_NAME}
```

## tests/lib/Network/testcase.yaml
```yaml
common:
  tags: network
  integration_platforms:
    - qemu_cortex_m3
tests:
  lib.Network: { }
```

## tests/lib/PID/testcase.yaml
```yaml
common:
  tags: extensibility
  integration_platforms:
    - dji_board_c
tests:
  lib.PID: { }
```

## tests/lib/Unit/Kconfig
```kconfig
menu "Zephyr"
source "Kconfig.zephyr"
endmenu

module = test
module-str = test
source "subsys/logging/Kconfig.template.log_config"
rsource "src/Units/Kconfig"
```

## tests/lib/applications/PRTS/src/Units/Kconfig
```kconfig
config HEAP_MEM_POOL_ADD_SIZE_PRTS_TEST
    int "PRTS 测试内存堆大小"
    default 20000
```

## tests/lib/applications/Unit/src/Units/Kconfig
```kconfig
config HEAP_MEM_POOL_ADD_SIZE_UNIT_TEST
    int "Unit Test heap size"
    default 20000
```

## tests/lib/applications/Unit/testcase.yaml
```yaml
common:
  tags: extensibility
  integration_platforms:
    - qemu_cortex_m3
tests:
  lib.Unit: { }
```

## tests/lib/custom/testcase.yaml
```yaml
common:
  tags: extensibility
  integration_platforms:
    - dji_board_c
tests:
  lib.custom: {}
  lib.custom.non_default:
    extra_args: CONFIG_CUSTOM_GET_VALUE_DEFAULT=6
```

## west.yml
```yaml
manifest:
  self:
    west-commands: scripts/west-commands.yml

  remotes:
    - name: zephyrproject-rtos
      url-base: https://github.com/zephyrproject-rtos
    - name: robomaster-dlmu
      url-base: https://github.com/RoboMaster-DLMU-CONE

  projects:
    - name: zephyr
      remote: zephyrproject-rtos
      revision: main
      import:
        name-allowlist:
          - cmsis
          - cmsis_6
          - hal_stm32
    - name: onemotor
      remote: robomaster-dlmu
      repo-path: OneMotor
      revision: main
      path: modules/lib/onemotor
    - name: rpl
      remote: robomaster-dlmu
      repo-path: rpl
      revision: main
      path: modules/lib/rpl
```
