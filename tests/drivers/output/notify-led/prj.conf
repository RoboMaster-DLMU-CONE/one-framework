## CMakeLists.txt
```
cmake_minimum_required(VERSION 3.20.0)
find_package(Zephyr REQUIRED HINTS $ENV{ZEPHYR_BASE})
project(OF_driver_notify_led_test)
target_sources(app PRIVATE src/main.cpp)
```

## prj.conf
```kconfig
CONFIG_ONE_FRAMEWORK=y
CONFIG_NOTIFY_LED=y
```

## src/main.cpp
```c
#include <zephyr/device.h>
#include <zephyr/logging/log.h>
#include <zephyr/kernel.h>

LOG_MODULE_REGISTER(main, CONFIG_LOG_DEFAULT_LEVEL);

int main()
{

    while (true)
    {
        k_sleep(K_MSEC(1000));
    }
}
```
