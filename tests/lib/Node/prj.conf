## CMakeLists.txt
```
cmake_minimum_required(VERSION 3.20.0)
find_package(Zephyr REQUIRED HINTS $ENV{ZEPHYR_BASE})
project(OF_lib_node_test)
target_sources(app PRIVATE src/main.cpp src/Nodes/chassis_node.cpp src/Nodes/gimbal_node.cpp)
```

## Kconfig
```
menu "Zephyr"
source "Kconfig.zephyr"
endmenu

module = test
module-str = test
source "subsys/logging/Kconfig.template.log_config"
```

## prj.conf
```kconfig
CONFIG_ONE_FRAMEWORK=y
CONFIG_NODE=y
CONFIG_LOG=y
CONFIG_CPU_LOAD=y
```

## src/main.cpp
```c
#include <zephyr/logging/log.h>
#include <zephyr/kernel.h>
#include <zephyr/debug/cpu_load.h>

#include <OF/lib/Node/NodeManager.hpp>


LOG_MODULE_REGISTER(node_test, CONFIG_LOG_DEFAULT_LEVEL);

using namespace OF;


int main()
{
    LOG_INF("main");

    start_all_nodes();

    while (true)
    {
        uint32_t load = cpu_load_get(false);
        LOG_INF("cpu: %u.%u%%", load / 10, load % 10);
        k_sleep(K_MSEC(500));
    }
}
```
