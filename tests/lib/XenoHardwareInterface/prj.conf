## CMakeLists.txt
```
cmake_minimum_required(VERSION 3.20.0)
find_package(Zephyr REQUIRED HINTS $ENV{ZEPHYR_BASE})
project(OF_XenoHardwareInterface_test)
target_sources(app PRIVATE src/main.cpp)
target_link_libraries(app PRIVATE onemotor)
```

## prj.conf
```kconfig
CONFIG_ZTEST=y
CONFIG_CBPRINTF_FP_SUPPORT=y

CONFIG_ONE_FRAMEWORK=y
CONFIG_ONEMOTOR=y
CONFIG_XENO_CONTROL=y
CONFIG_XENO_HARDWARE_INTERFACE=y
```

## src/main.cpp
```c
// Copyright (c) 2025. MoonFeather
// SPDX-License-Identifier: BSD-3-Clause

#include <zephyr/ztest.h>
#include <OF/lib/XenoHardwareInterface/XenoHardwareInterface.hpp>

ZTEST_SUITE(XenoHardwareInterface, nullptr, nullptr, nullptr, nullptr, nullptr);

ZTEST(XenoHardwareInterface, test_header_inclusion)
{
    // This test primarily ensures that the headers compile correctly
    // and the namespace is properly defined
    
    // Basic compilation test - if this compiles, the headers are working
    zassert_true(true, "XenoHardwareInterface headers compile successfully");
}

// Note: Full hardware interface testing would require proper CAN hardware setup
// For now, we focus on basic compilation tests
```
