## CMakeLists.txt
```
cmake_minimum_required(VERSION 3.20.0)
find_package(Zephyr REQUIRED HINTS $ENV{ZEPHYR_BASE})
project(VtHubTest)

target_sources(app PRIVATE src/main.cpp)
```

## prj.conf
```kconfig
CONFIG_LOG=y
CONFIG_CBPRINTF_FP_SUPPORT=y
CONFIG_ONE_FRAMEWORK=y
CONFIG_VT_HUB=y
```

## app.overlay
```dts
/ {
    vthub {
        compatible = "one-framework,vt-hub";
        input-device = <&usart6>;
    };
};
```

## src/main.cpp
```c
#include <zephyr/kernel.h>
#include <zephyr/logging/log.h>
#include <OF/lib/VtHub/VtHub.hpp>
#include "RPL/Packets/VT03RemotePacket.hpp"

LOG_MODULE_REGISTER(main, LOG_LEVEL_INF);

using namespace OF;

int main(void)
{
    LOG_INF("VtHub Test Started");

    while (true)
    {
        k_sleep(K_MSEC(100));

        auto res = VtHub::get<VT03RemotePacket>();

        if (res)
        {
            auto& rc = res.value();
            LOG_INF("VT03: LX=%u LY=%u RX=%u RY=%u W=%u SW=%u", 
                    (unsigned)rc.left_stick_x(), (unsigned)rc.left_stick_y(), 
                    (unsigned)rc.right_stick_x(), (unsigned)rc.right_stick_y(),
                    (unsigned)rc.wheel(), (unsigned)rc.switch_state());
        }
    }
    return 0;
}
```
