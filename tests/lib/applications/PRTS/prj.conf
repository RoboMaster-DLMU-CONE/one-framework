## CMakeLists.txt
```
cmake_minimum_required(VERSION 3.20.0)
find_package(Zephyr REQUIRED HINTS $ENV{ZEPHYR_BASE})
project(OF_lib_applications_PRTS_test)

target_sources(app PRIVATE src/main.cpp src/Units/Chassis.cpp)
```

## Kconfig
```
menu "Zephyr"
source "Kconfig.zephyr"
endmenu

module = test_prts
module-str = test_prts
source "subsys/logging/Kconfig.template.log_config"
rsource "src/Units/Kconfig"
```

## prj.conf
```kconfig
CONFIG_ONE_FRAMEWORK=y
CONFIG_PRTS=y
```

## src/main.cpp
```c
#include "OF/lib/applications/PRTS/PrtsManager.hpp"
#include "OF/lib/applications/Unit/Unit.hpp"
#include "zephyr/kernel.h"

[[noreturn]] int main()
{
    OF::StartUnits();
    OF::Prts::PrtsManager::initShell();
    while (true)
    {
        k_sleep(K_SECONDS(1U));
    }
}
```
