## dts/bindings/sensor/pwm_heater.yaml
```yaml
description: PWM加热器设备绑定

compatible: "pwm-heater"

include: [ base.yaml ]

properties:
  pwms:
      required: true
      type: phandle-array
      description: |
        Reference to a PWM instance.
  temp-sensor:
    type: phandle
    required: true
    description: 温度传感器设备

  temp-channel:
    type: int
    required: true
    description: 温度传感器通道
```

## dts/bindings/status-leds/status-leds.yaml
```yaml
description: System Status Indicator LEDs

compatible: "status-leds"

include: base.yaml

properties:
  leds:
    type: phandle
    required: true
    description: 引用到LED节点
  heartbeat-led-index:
    type: int
    required: true
    description: 心跳指示灯的led序号
  error-led-index:
    type: int
    required: true
    description: 错误指示灯的led序号
```

## lib/CommBridge/Kconfig
```kconfig
menuconfig COMM_BRIDGE
    bool "CommunicationBridge"
    select STDOUT_CONSOLE
    select UART_LINE_CTRL
    select RPL
    help
        启用OneFramework通信桥接器

if COMM_BRIDGE

module = COMM_BRIDGE
module-str = CommBridge
source "subsys/logging/Kconfig.template.log_config"

config COMM_BRIDGE_RX_TIMEOUT_US
    int "UART RX timeout in microseconds"
    default 100000
    help
    	UART异步接收操作的最大延时（默认100ms）

config COMM_BRIDGE_MAX_RX_SIZE
	int "UART Max Receive size"
	default 4096
	help
		UART异步接收的最大大小（Byte）

endif # 通信桥接器
```

## lib/ControllerCenter/Kconfig
```kconfig
menuconfig CONTROLLER_CENTER
    bool "ControllerCenter"
    depends on INPUT_DBUS || INPUT_SBUS
    help
        启用OneFramework控制器中心

if CONTROLLER_CENTER

module = CONTROLLER_CENTER
module-str = ControllerCenter
source "subsys/logging/Kconfig.template.log_config"


endif # CONTROLLER_CENTER
```

## lib/ControllerHub/Kconfig
```kconfig
menuconfig CONTROLLER_HUB
    bool "ControllerHub"
    select HUB_MANAGER
    help
        启用OneFramework控制器中心

if CONTROLLER_HUB

module = CONTROLLER_HUB
module-str = ControllerHub
source "subsys/logging/Kconfig.template.log_config"


endif # CONTROLLER_HUB
```

## lib/HubManager/Kconfig
```kconfig
menuconfig HUB_MANAGER
    depends on ONE_FRAMEWORK
    bool "Hub Manager"
    help
        启用 OneFramework Hub 管理器

module = HUB_MANAGER
module-str = HUB_MANAGER
source "subsys/logging/Kconfig.template.log_config"
```

## lib/IMUCenter/Kconfig
```kconfig
menuconfig IMU_CENTER
    bool "IMUService"
    select SENSOR
    help
        启用 OneFramework IMU 中心

if IMU_CENTER

choice
    prompt "IMU Device"
    default IMU_CENTER_USE_BMI08X
    help
        IMU中心使用的IMU设备

config IMU_CENTER_USE_BMI08X
    bool "IMU Center use BMI08x"
    select BMI08X
    select SENSOR_ASYNC_API
    help
        使用BMI08X作为IMU Center设备
endchoice

config IMU_CENTER_SAMPLING_FREQUENCY
    int "IMU Center Sampling Frequency (Hz)"
    range 1 1000
    default 10
    depends on IMU_CENTER
    help
        设置IMU中心的采样频率（Hz）

module = IMU_CENTER
module-str = IMU_CENTER
source "subsys/logging/Kconfig.template.log_config"


endif # IMU_CENTER
```

## lib/ImuHub/Kconfig
```kconfig
menuconfig IMU_HUB
    bool "IMU Hub"
    select SENSOR
    select HUB_MANAGER
    help
        启用 OneFramework IMU 中心

if IMU_HUB

choice
    prompt "IMU Device"
    default IMU_HUB_USE_BMI08X
    help
        IMU中心使用的IMU设备

config IMU_HUB_USE_BMI08X
    bool "IMU Hub use BMI08x"
    select BMI08X
    select SENSOR_ASYNC_API
    help
        使用BMI08X作为IMU Hub设备
endchoice

config IMU_HUB_SAMPLING_FREQUENCY
    int "IMU Hub Sampling Frequency (Hz)"
    range 1 2000
    default 10
    depends on IMU_HUB
    help
        设置IMU中心的采样频率（Hz）

menu "RTIO Thread"

config IMU_HUB_RTIO_STACK_SIZE
    int "IMU Hub RTIO线程栈大小"
    range 512 8192
    default 1024
    help
        RTIO完成回调线程的栈大小，数值越大可容纳更多解析逻辑。

config IMU_HUB_RTIO_THREAD_PRIORITY
    int "IMU Hub RTIO线程优先级"
    default 0
    help
        RTIO完成回调线程的优先级，数值越小优先级越高。
        设为0表示自动使用 K_LOWEST_APPLICATION_THREAD_PRIO，避免打断日志线程。

config IMU_HUB_PUBLISH_EVERY_N_FRAME
    int "IMU Hub 数据更新频率"
    default 10
    help
        在硬件采集 [该值] 帧 后更新数据给外部访问，这个值越大，对外部来说，Imu Hub的数据更新频率越慢，CPU占用越小

endmenu

menu "Algorithm"

choice IMU_HUB_RESOLVER
    prompt "IMU Hub 解算器"
    default IMU_HUB_RESOLVER_MAHONY
    help
        IMU Hub 使用的解算器，默认使用Mahony解算器。若设置为IMU_HUB_RESOLVER_NONE则不会进行数据解算，
        只会发布未处理的数据。届时IMUData结构体的定义也将发生变化。

config IMU_HUB_RESOLVER_NONE
    bool "IMU Hub 不使用解算器"
    help
        不使用任何解算器对IMU数据进行解算

config IMU_HUB_RESOLVER_MAHONY
    bool "IMU Hub Mahony解算器"
    help
        使用 Mahony 互补滤波算法对 6-DOF IMU数据进行解算，得出四元数和欧拉角

endchoice

endmenu
module = IMU_HUB
module-str = IMU_HUB
source "subsys/logging/Kconfig.template.log_config"


endif # IMU_HUB
```

## lib/Kconfig
```kconfig
menu "OneFramework Libraries"

rsource "SbusHub/Kconfig"
rsource "VtHub/Kconfig"
rsource "ImuHub/Kconfig"
rsource "NotifyHub/Kconfig"
rsource "CommBridge/Kconfig"
rsource "Node/Kconfig"

endmenu
```

## lib/Network/Kconfig
```kconfig
# Copyright (c) 2025. MoonFeather
# SPDX-License-Identifier: BSD-3-Clause

config NETWORK
	bool "Network Interface Management"
	default n
	help
	  Enable Network interface management system with support for
	  CAN and VCAN interfaces. Provides Netlink communication and
	  Daemon-based interface management.

if NETWORK

config NETWORK_LOG_LEVEL
	int "Network module log level"
	default 3
	range 0 4
	help
	  Set the log level for Network module components:
	  0 - OFF, 1 - ERROR, 2 - WARNING, 3 - INFO, 4 - DEBUG

config NETWORK_MAX_INTERFACES
	int "Maximum number of network interfaces"
	default 8
	range 1 32
	help
	  Maximum number of network interfaces that can be managed
	  simultaneously by the Network module.

config NETWORK_INTERFACE_NAME_MAX_LEN
	int "Maximum interface name length"
	default 15
	range 8 32
	help
	  Maximum length for network interface names. Standard Linux
	  limit is 15 characters.

endif # NETWORK
```

## lib/Node/Kconfig
```kconfig
menuconfig NODE
    bool "OneFramework Node"
    help
        启用OneFramework Node

if NODE

config TOPIC_BUFFER_N
    int "Topic 缓冲区数量"
    default 10
    help
        N >= 2
        设定Topic消息缓冲区数量。数量越大，消费者读取的延迟越低，Topic占用的内存越大。

module = NODE
module-str = Node
source "subsys/logging/Kconfig.template.log_config"

endif # NODE
```

## lib/NotifyHub/Kconfig
```kconfig
menuconfig NOTIFY_HUB
    bool "Notify Hub"
    select HUB_MANAGER
    select STATUS_LEDS
    select PWM_BUZZER

    help
        启用 OneFramework 通知中心

if NOTIFY_HUB

module = NOTIFY_HUB
module-str = NotifyHub
source "subsys/logging/Kconfig.template.log_config"

endif
```

## lib/SbusHub/Kconfig
```kconfig
menuconfig SBUS_HUB
    bool "SbusHub"
    select HUB_MANAGER
    help
        启用OneFramework Sbus中心 (DBUS/SBUS Receiver)

if SBUS_HUB

module = SBUS_HUB
module-str = SbusHub
source "subsys/logging/Kconfig.template.log_config"


endif # SBUS_HUB
```

## lib/Unit/Kconfig
```kconfig
menuconfig UNIT
    bool "Unit"
    select DYNAMIC_THREAD
    select DYNAMIC_THREAD_ALLOC
    help
        Enable One Framework's Unit in Application Layer.

if UNIT

module = UNIT
module-str = Unit
source "subsys/logging/Kconfig.template.log_config"

config UNIT_THREAD_ANALYZER
    bool "为Unit启用线程分析"
    default y
    select THREAD_ANALYZER
    select THREAD_RUNTIME_STATS_USE_TIMING_FUNCTIONS
    help
        自动启用Zephyr的线程分析器功能，用于监控每个线程的CPU、内存使用率。

if UNIT_THREAD_ANALYZER
    config THREAD_ANALYZER_ISR_STACK_USAGE
    default n
endif

config UNIT_RESTART_WAITING_TIME
    int "Unit重启最大等待时间"
    default 2000
    help
        单位：毫秒


endif # UNIT
```

## lib/VtHub/Kconfig
```kconfig
menuconfig VT_HUB
    bool "Enable VtHub"
    default y
    select RPL
    help
      Enable RoboMaster 2026 Video Transmission Link Hub

if VT_HUB

module = VT_HUB
module-str = VtHub
source "subsys/logging/Kconfig.template.log_config"

endif
```

## lib/XenoControl/Kconfig
```kconfig
config XENO_CONTROL
	bool "Xeno Control Library"
	depends on ONEMOTOR
	help
	  Enable the Xeno Control library for robotic arm joint control.
	  Provides unified interface for managing 7-DOF robotic arm joints
	  using OneMotor M3508 motors.

if XENO_CONTROL

config XENO_CONTROL_LOG_LEVEL
	int "Xeno Control Log Level"
	depends on LOG
	default 3
	range 0 4
	help
	  Set log level for Xeno Control library:
	  0 = OFF, 1 = ERROR, 2 = WARNING, 3 = INFO, 4 = DEBUG

endif # XENO_CONTROL
```

## lib/XenoHardwareInterface/Kconfig
```kconfig
config XENO_HARDWARE_INTERFACE
	bool "Xeno Hardware Interface"
	depends on XENO_CONTROL
	help
	  Enable the Xeno Hardware Interface for high-level robotic arm control.
	  Provides a unified interface for controlling the 7-DOF robotic arm
	  through the Xeno Control joints system.

if XENO_HARDWARE_INTERFACE

config XENO_HARDWARE_INTERFACE_LOG_LEVEL
	int "Xeno Hardware Interface Log Level"
	depends on LOG
	default 3
	range 0 4
	help
	  Set log level for Xeno Hardware Interface:
	  0 = OFF, 1 = ERROR, 2 = WARNING, 3 = INFO, 4 = DEBUG

endif # XENO_HARDWARE_INTERFACE
```

## lib/applications/PRTS/Kconfig
```kconfig
menuconfig PRTS
    bool "PRTS"
    select UNIT
    select SHELL
    select SERIAL
    select SHELL_BACKEND_SERIAL

    help
        启用 P.R.T.S. (Primitive RoboMaster Terminal Service).

if PRTS

config HEAP_MEM_POOL_ADD_SIZE_PRTS
    int "PRTS预分配堆内存"
    default 5000
    help
        PRTS所需的堆大小

config SHELL_ECHO_STATUS
    bool "终端ECHO效果"
    default n
    help
        影响桌面端程序解析字符串，默认关闭

endif # PRTS
```

## lib/applications/Unit/Kconfig
```kconfig
menuconfig UNIT
    bool "Unit"
    select DYNAMIC_THREAD
    select DYNAMIC_THREAD_ALLOC
    help
        Enable One Framework's Unit in Application Layer.

if UNIT

config UNIT_LOG_LEVEL
    int "Unit系统日志级别"
    default 3
    range 0 4
    help
        设置Unit系统的日志级别：
        - 0: OFF
        - 1: ERROR
        - 2: WARNING
        - 3: INFO
        - 4: DEBUG

config UNIT_THREAD_ANALYZER
    bool "Enable Thread Analyzer for thread monitoring"
    default y
    select THREAD_ANALYZER
#     select THREAD_RUNTIME_STATS_USE_TIMING_FUNCTIONS
    help
          自动启用Zephyr的线程分析器功能，用于监控每个线程的CPU、内存使用率。

endif # UNIT
```

## lib/modules/ControllerCenter/Kconfig
```kconfig
menuconfig CONTROLLER_CENTER
    bool "ControllerCenter"
    depends on INPUT_DBUS || INPUT_SBUS
    help
        启用OneFramework控制器中心

if CONTROLLER_CENTER

config CONTROLLER_CENTER_LOG_LEVEL
    int "控制器中心系统日志级别"
    default 3
    range 0 4
    help
        设置控制器中心系统的日志级别
        - 0: OFF
        - 1: ERROR
        - 2: WARNING
        - 3: INFO
        - 4: DEBUG


endif # CONTROLLER_CENTER
```
