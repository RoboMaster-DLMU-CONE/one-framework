#include <zephyr/dt-bindings/lvgl/lvgl.h>

&spi2 {
	pinctrl-0 = <&spi2_sck_pb13 &spi2_miso_pb14 &spi2_mosi_pb15>;
	pinctrl-names = "default";
	status = "okay";
	cs-gpios = <&gpiob 12 GPIO_ACTIVE_LOW>;
};

&mipi_dbi {
	spi-dev = <&spi2>;
	dc-gpios = <&gpiof 0 GPIO_ACTIVE_HIGH>;
	reset-gpios = <&gpiof 1 GPIO_ACTIVE_LOW>;
};