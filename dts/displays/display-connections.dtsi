/ {
	ili9341_mipi_dbi: mipi_dbi {
		compatible = "zephyr,mipi-dbi-spi";
		#address-cells = <1>;
		#size-cells = <0>;
		write-only;

		spi-dev = <&spi2>;
		dc-gpios = <&gpiof 0 GPIO_ACTIVE_HIGH>;
		reset-gpios = <&gpiof 1 GPIO_ACTIVE_LOW>;

		display-controller = <&ili9341>;
	};
};