## Kconfig
```kconfig
config OUTPUT
    bool "Output drivers"
    help
        Enable support for output drivers like buzzers, motors, etc.

config ONE_FRAMEWORK
    bool "One Framework框架"
    select SERIAL
    select CONSOLE
    select LOG
#     select CBPRINTF_FP_SUPPORT
    select UART_CONSOLE
    select LOG_BACKEND_UART_OUTPUT
    select CPP
    select REQUIRES_FULL_LIBCPP
    select INPUT
    select OUTPUT
    help
        启用One Framework框架。
        包含了One Framework框架的默认、常用Kconfig选项。

if ONE_FRAMEWORK

choice STD_CPP
    prompt "C++ Standard"
    depends on CPP
    default STD_CPP20
endchoice

rsource "drivers/Kconfig"
rsource "lib/Kconfig"
endif # ONE_FRAMEWORK
```

## boards/dji/dji_board_c/Kconfig.dji_board_c
```kconfig
config BOARD_DJI_BOARD_C
    bool
    select SOC_STM32F407XG
if BOARD_DJI_BOARD_C

config DT_HAS_PWM_LEDS_ENABLED
        bool
        default y

config DT_HAS_ZEPHYR_SWDP_GPIO_ENABLED
        bool
        default y

config DT_HAS_BOSCH_BMI08X_ACCEL_ENABLED
        bool
        default y

config DT_HAS_BOSCH_BMI08X_GYRO_ENABLED
        bool
        default y

config CONSOLE_HAS_DRIVER
		bool
		default y

config SERIAL_SUPPORT_INTERRUPT
        bool
        default y

config BOARD_DJI_BOARD_C_USB_COMM
        bool "Enable DJI Board C USB Communication (CDC ACM)"
        depends on BOARD_DJI_BOARD_C
        help
          Enable USB CDC ACM support for DJI Board C.
          This allows the board to communicate with a host PC via USB
          using the CDC ACM (Communication Device Class - Abstract Control Model) protocol.
          When enabled, USB device stack and CDC ACM class will be configured automatically.

if BOARD_DJI_BOARD_C_USB_COMM

	config USB_DEVICE_STACK_NEXT
			bool
			default y

	config USBD_CDC_ACM_CLASS
			bool
			default y

	config CDC_ACM_SERIAL_INITIALIZE_AT_BOOT
			bool
			default y

	config UART_LINE_CTRL
			bool
			default y

	config STDOUT_CONSOLE
			bool
			default y

	config CDC_ACM_SERIAL_PID
			hex
			default 0x0004

    config CDC_ACM_SERIAL_MANUFACTURER_STRING
            string
            default "WeaveFeather"

	config CDC_ACM_SERIAL_PRODUCT_STRING
			string
			default "TeamCOnePresent"

	choice USBD_LOG_LEVEL_CHOICE
            default USBD_LOG_LEVEL_WRN
    endchoice

    choice USBD_CDC_ACM_LOG_LEVEL_CHOICE
            default USBD_CDC_ACM_LOG_LEVEL_WRN
    endchoice

    choice UDC_DRIVER_LOG_LEVEL_CHOICE
            default UDC_DRIVER_LOG_LEVEL_WRN
    endchoice

endif # BOARD_DJI_BOARD_C_USB_COMM

config BOARD_DJI_BOARD_C_PWM_HEATER
    bool "大疆开发板C型 使用PWM加热"
    depends on SENSOR
    select PWM_HEATER
    default y
    help
        大疆开发板C型

endif # BOARD_DJI_BOARD_C
```

## boards/dji/dji_board_c/board.yml
```yaml
board:
  name: dji_board_c
  full_name: DJI RoboMaster Development Board C
  vendor: DJI
  socs:
    - name: stm32f407xx
```

## boards/dji/dji_board_c/dji_board_c_defconfig
```kconfig
CONFIG_ARM_MPU=y
CONFIG_MPU_ALLOW_FLASH_WRITE=y
CONFIG_FPU=y
CONFIG_CORTEX_M_DWT=y
CONFIG_HW_STACK_PROTECTION=y
CONFIG_GPIO=y
CONFIG_LED=y
CONFIG_UART_INTERRUPT_DRIVEN=y
CONFIG_PWM=y
CONFIG_LED_PWM=n
```

## boards/dmBot/dm_mc02/board.yml
```yaml
board:
  name: dm_mc02
  full_name: DaMiao MC02
  vendor: dmBot
  socs:
    - name: stm32h723xx
```

## drivers/Kconfig
```kconfig
menu "OneFramework Drivers"

rsource "output/Kconfig"

if SENSOR
rsource "sensor/Kconfig"
endif # SENSOR

endmenu
```

## drivers/input/Kconfig.dbus
```kconfig
config INPUT_DBUS
	bool "DBUS 驱动"
	default n
	depends on INPUT
	depends on UART_INTERRUPT_DRIVEN
	select UART_USE_RUNTIME_CONFIGURE
	help
	  启用DBUS遥控驱动。

if INPUT_DBUS

config INPUT_DBUS_THREAD_STACK_SIZE
	int "DBUS线程栈大小"
	default 1024
	help
	  DBUS线程使用的栈大小。

config INPUT_DBUS_THREAD_PRIORITY
	int "Priority for the DBUS thread"
	default 0
	help
	  Priority level of the sbus thread.

config INPUT_DBUS_REPORT_FILTER
	int "Minimal change in signal to report"
	default 1
	help
	  DBUS tends to be a bit noisy you can increase the threshold to
	  lower the amounts of input events. Set to 0 for no filtering

config INPUT_DBUS_SEND_SYNC
	bool "Send Sync to input subsys on each SBUS frame"
	default y
	help
	  Sends sync message to input subsys with sync bit.

config INPUT_DBUS_CHANNEL_VALUE_ONE
	int "Threshold value > for INPUT_EV_KEY value 1"
	default 1800
	help
	  SBUS sends analogue values for digital switches. This config value
	  sets the threshold to interperted the analogue value as an logic 1

config INPUT_DBUS_CHANNEL_VALUE_ZERO
	int "Threshold value < for INPUT_EV_KEY value 0"
	default 1200
	help
	  SBUS sends analogue values for digital switches. This config value
	  sets the threshold to interperted the analogue value as an logic 0

endif # INPUT_DBUS
```

## drivers/output/buzzer/Kconfig
```kconfig
menuconfig PWM_BUZZER
    bool "PWM蜂鸣器驱动"
    select PWM
    help
        启用基于PWM的蜂鸣器驱动，用于产生不同音高和响度的声音

if PWM_BUZZER

config PWM_BUZZER_NAME
    string "PWM蜂鸣器设备名称"
    default "PWM_BUZZER"
    help
        PWM蜂鸣器设备的名称

config PWM_BUZZER_INIT_PRIORITY
    int "PWM蜂鸣器初始化优先级"
    default 90
    help
        PWM蜂鸣器设备驱动初始化优先级

module = PWM_BUZZER
module-str = PWM_BUZZER
source "subsys/logging/Kconfig.template.log_config"

config PWM_BUZZER_DEFAULT_VOLUME
    int "默认音量(0-100)"
    range 0 100
    default 50
    help
        蜂鸣器默认音量，范围0-100

endif # PWM_BUZZER
```

## drivers/output/led_pixel/Kconfig
```kconfig
menuconfig LED_PIXEL
    bool "像素LED"
    help
        启用像素LED

if LED_PIXEL


module = LED_PIXEL
module-str = LEDPixel
source "subsys/logging/Kconfig.template.log_config"

endif # LED_PIXEL
```

## drivers/output/notify-led/Kconfig
```kconfig
menuconfig NOTIFY_LED
    bool "信息通知LED"
    help
        启用基于信息通知LED

if NOTIFY_LED


module = NOTIFY_LED
module-str = NotifyLED
source "subsys/logging/Kconfig.template.log_config"

endif # NOTIFY_LED
```

## drivers/output/status-leds/Kconfig
```kconfig
menuconfig STATUS_LEDS
    bool "System Status Indicator LEDs"
    select LED
    help
        Enable driver for system status LEDs (heartbeat and error indicators)

if STATUS_LEDS

config LED_INIT_PRIORITY
    default 50

config STATUS_LEDS_INIT_PRIORITY
	int "Status LEDS device drivers init priority"
	default 90
	help
	    status_leds device drivers init priority.

module = STATUS_LEDS
module-str = STATUS_LEDS
source "subsys/logging/Kconfig.template.log_config"

config HEARTBEAT_LED_BLINK_INTERVAL
    int "Heartbeat LED blink interval in ms"
        default 300
        help
        Heartbeat LED blink interval in milliseconds

config ERROR_LED_INTERVAL
    int "Error LED interval in ms"
        default 1000
        help
        Error LED interval in milliseconds



endif # STATUS_LEDS
```

## drivers/sensor/pwm_heater/Kconfig
```kconfig
menuconfig PWM_HEATER
    bool "PWM Heater"
    select PWM
    depends on SENSOR
    select SENSOR_ASYNC_API
    help
        启用基于PID控制的PWM加热器驱动，用于控制传感器温度

if PWM_HEATER

config PWM_HEATER_NAME
    string "PWM加热器设备名称"
    default "PWM_HEATER"
    help
        PWM加热器设备的名称

config PWM_HEATER_INIT_PRIORITY
    int "PWM加热器初始化优先级"
    default 90
    help
        PWM加热器设备驱动初始化优先级

config PWM_HEATER_TARGET_TEMP
    int "目标温度(摄氏度x100)"
    default 4500
    help
        目标温度值，单位为摄氏度x100(例如：5000表示50.00°C)

config PWM_HEATER_TEMP_TOLERANCE
    int "温度容差范围(摄氏度x100)"
    default 20
    help
        温度容差范围，单位为摄氏度x100(例如：20表示±0.20°C)

config PWM_HEATER_UPDATE_INTERVAL_MS
    int "PID控制器更新间隔(毫秒)"
    default 500
    help
        PID控制器更新间隔，单位为毫秒

config PWM_HEATER_PID_KP
    int "PID比例系数(x1000)"
    default 5000
    help
        PID控制器比例系数，放大1000倍

config PWM_HEATER_PID_KI
    int "PID积分系数(x1000)"
    default 500
    help
        PID控制器积分系数，放大1000倍

config PWM_HEATER_PID_KD
    int "PID微分系数(x1000)"
    default 100
    help
        PID控制器微分系数，放大1000倍

config PWM_HEATER_MAX_DUTY_CYCLE_PCT
    int "最大占空比(%)"
    range 0 100
    default 100
    help
        PWM最大占空比限制，防止过热

config PWM_HEATER_PID_AUTO_MAX_OUTPUT
    bool "自动将PID最大输出映射到PWM占空比"
    default y
    help
        选择后，PID输出最大值自动等于最大占空比百分比，无需手动换算。

config PWM_HEATER_PID_MAX_OUTPUT
    int "PID最大输出(手动模式)"
    default 1000
    depends on !PWM_HEATER_PID_AUTO_MAX_OUTPUT
    help
        当未启用自动映射时使用，决定PID输出上限的刻度。

config PWM_HEATER_AUTOSTART
    bool "系统初始化时自动启动加热器"
    default y
    help
        选中后，无需在应用中调用 pwm_heater_enable()，驱动会在 SYS_INIT 阶段自动启动。

module = PWM_HEATER
module-str = PWM_HEATER
source "subsys/logging/Kconfig.template.log_config"

endif # PWM_HEATER
```

## drivers/utils/status-leds/Kconfig
```kconfig
menuconfig STATUS_LEDS
    bool "System Status Indicator LEDs"
    select LED
    help
        Enable driver for system status LEDs (heartbeat and error indicators)

if STATUS_LEDS

config LED_INIT_PRIORITY
    default 50

config STATUS_LEDS_INIT_PRIORITY
	int "Status LEDS device drivers init priority"
	default 90
	help
	    status_leds device drivers init priority.

config STATUS_LEDS_LOG_LEVEL
    int "Status LEDS device drivers log level"
    default LOG_DEFAULT_LEVEL
    help
        status_leds device drivers log level.

config HEARTBEAT_LED_BLINK_INTERVAL
    int "Heartbeat LED blink interval in ms"
        default 300
        help
        Heartbeat LED blink interval in milliseconds

config ERROR_LED_INTERVAL
    int "Error LED interval in ms"
        default 1000
        help
        Error LED interval in milliseconds

module = STATUS_LEDS
module-str = status_leds


endif # STATUS_LEDS
```

## dts/bindings/input/dji,dbus.yaml
```yaml
# Copyright (c) 2025 MoonFeather
# SPDX-License-Identifier: BSD-3-Clause

description: |
  DJI DBUS输入驱动
  该驱动实现了DJI遥控器使用的DBUS协议，用于传输摇杆、开关、鼠标和键盘输入。
  DBUS是通过UART通信的协议，使用100000波特率，偶校验，2个停止位。
  驱动将DBUS信号绑定到Zephyr输入系统使用INPUT_EV_CODES。

  配置示例:
  &usart3 {
    status = "okay";
    dbus {
        compatible = "dji,dbus";
        status = "okay";
    };
  };


compatible: "dji,dbus"

include: [ base.yaml, uart-device.yaml ]
```

## dts/bindings/one-framework,imu-hub.yaml
```yaml
description: IMU Hub for One Framework

compatible: "one-framework,imu-hub"

properties:
  accel-device:
    type: phandle
    required: true
    description: Accelerometer device

  gyro-device:
    type: phandle
    required: true
    description: Gyroscope device
```

## dts/bindings/one-framework,notify-hub.yaml
```yaml
description: Notify Hub for One Framework

compatible: "one-framework,notify-hub"

properties:
  led-pixel-device:
    type: phandle
    required: true
    description: LED Pixel device (e.g. WS2812)

  pwm-buzzer-device:
    type: phandle
    required: true
    description: PWM Buzzer device
```

## dts/bindings/one-framework,sbus-hub.yaml
```yaml
description: SBUS Hub for One Framework (e.g. DJI DT7)

compatible: "one-framework,sbus-hub"

properties:
  input-device:
    type: phandle
    required: true
    description: UART device connected to the SBUS receiver
```

## dts/bindings/one-framework,vt-hub.yaml
```yaml
description: VT Hub for One Framework (RoboMaster 2026 Video Transmission Link)

compatible: "one-framework,vt-hub"

properties:
  input-device:
    type: phandle
    required: true
    description: UART device connected to the VT receiver
```

## dts/bindings/output/led-pixel-pwm.yaml
```yaml
description: Proxy driver for RGB LEDs composed of individual PWM/GPIO LEDs
compatible: "led-pixel-pwm"

properties:
  red-led:
    type: phandle
    required: true
    description: Reference to the Red LED node (in pwm-leds or gpio-leds)
  green-led:
    type: phandle
    required: true
  blue-led:
    type: phandle
    required: true
```

## dts/bindings/output/led-pixel-strip.yaml
```yaml
description: Proxy driver for a single pixel on an LED strip
compatible: "led-pixel-strip"

properties:
  chain:
    type: phandle
    required: true
    description: Reference to the led-strip device node
  pixel-index:
    type: int
    required: true
    description: Index of the pixel on the strip (0, 1, 2...)
```

## dts/bindings/output/pwm-buzzer.yaml
```yaml
# Copyright (c) 2025 MoonFeather
# SPDX-License-Identifier: BSD-3-Clause

description: PWM-driven buzzer

compatible: "pwm-buzzer"

include: base.yaml

properties:
  pwms:
    required: true
    type: phandle-array
    description: |
      PWM specifier driving this buzzer.

  base-frequency-hz:
    required: true
    type: int
    description: |
      Base frequency in Hz for the buzzer. This is used as a reference
      frequency for musical notes.
```
