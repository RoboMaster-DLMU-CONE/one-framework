## boards/dmBot/dm_mc02/Kconfig.dm_mc02
```kconfig
config BOARD_DM_MC02
    bool
    select SOC_STM32H723XX
if BOARD_DM_MC02

config DT_HAS_ARM_DTCM_ENABLED
        bool
        default y

config DT_HAS_ZEPHYR_SWDP_GPIO_ENABLED
        bool
        default y

config GEN_IRQ_VECTOR_TABLE
        bool
        default y

config ISR_TABLES_LOCAL_DECLARATION_SUPPORTED
        bool
        default y

config DT_HAS_BOSCH_BMI08X_ACCEL_ENABLED
        bool
        default y

config DT_HAS_BOSCH_BMI08X_GYRO_ENABLED
        bool
        default y

config CONSOLE_HAS_DRIVER
    		bool
	    	default y

config SERIAL_SUPPORT_INTERRUPT
        bool
        default y


config BOARD_DM_MC_02_PWM_HEATER
    bool "DM MC02 use PWM to heat IMU"
    depends on SENSOR
    select PWM_HEATER
    default y
    help
        DM MC02 use PWM to heat IMU

endif # BOARD_DM_MC02
```
